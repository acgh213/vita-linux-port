## buildroot-vita/package/python-hyfetch/Config.in
```kconfig
config BR2_PACKAGE_PYTHON_HYFETCH
	bool "python-hyfetch"
	depends on BR2_USE_MMU
	depends on BR2_USE_WCHAR
	depends on BR2_TOOLCHAIN_HAS_THREADS
	depends on !BR2_STATIC_LIBS
	select BR2_PACKAGE_PYTHON3
	select BR2_PACKAGE_PYTHON3_READLINE
	select BR2_PACKAGE_NEOFETCH
	help
	  HyFetch is a Python system-information display with configurable
	  pride-flag colour presets. The Vita image uses the neofetch backend.

	  https://github.com/hykilpikonna/hyfetch
```
